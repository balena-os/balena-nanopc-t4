## layers/meta-balena-nanopc-t4/conf/layer.conf
```bitbake
BBPATH .= ":${LAYERDIR}"

BBFILES += "${LAYERDIR}/recipes-*/*/*.bb \
            ${LAYERDIR}/recipes-*/*/*.bbappend"

BBFILE_COLLECTIONS += "balena-nanopc-t4"
BBFILE_PATTERN_balena-nanopc-t4 := "^${LAYERDIR}/"
BBFILE_PRIORITY_balena-nanopc-t4 = "1337"

BBMASK += "/meta-nanopc-t4/recipes-bsp/u-boot/u-boot-rockchip.bb"

LAYERSERIES_COMPAT_balena-nanopc-t4 = "thud"
```

## layers/meta-balena-nanopc-t4/conf/machine/smarc-px30.conf
```bitbake
#@TYPE: Machine
##@NAME: smarc-px30
##@DESCRIPTION: Machine configuration for the I-Pi SMARC PX30

MACHINEOVERRIDES = "lec-px30:${MACHINE}"
include conf/machine/lec-px30.conf
```

## layers/meta-lec-px30/conf/layer.conf
```bitbake
# We have a conf and classes directory, add to BBPATH
BBPATH .= ":${LAYERDIR}"

# We have a packages directory, add to BBFILES
BBFILES += "${LAYERDIR}/recipes-*/*/*.bb \
            ${LAYERDIR}/recipes-*/*/*.bbappend"

BBFILE_COLLECTIONS += "nanopc-t4"
BBFILE_PATTERN_nanopc-t4 := "^${LAYERDIR}/"
BBFILE_PRIORITY_nanopc-t4 = "6"

LAYERSERIES_COMPAT_nanopc-t4 = "thud"
```

## layers/meta-lec-px30/conf/machine/lec-px30.conf
```bitbake
#@TYPE: Machine
#@NAME: ADLINK LEC-PX30
#@SOC: Rockchip PX30
#@DESCRIPTION: Machine configuration for ADLINK LEC-PX30

require conf/machine/include/arm/arch-armv8.inc
require conf/machine/include/soc-family.inc
# require conf/machine/include/px30.inc

PREFERRED_PROVIDER_virtual/bootloader = "u-boot-rockchip"
PREFERRED_PROVIDER_virtual/kernel = "linux-rockchip"
PREFERRED_VERSION_linux-rockchip = "4.4.185%"

UBOOT_MACHINE = "evb-px30_defconfig"

KERNEL_IMAGETYPE = "Image"

SERIAL_CONSOLES = "1500000;ttyFIQ0"

#KBUILD_DEFCONFIG = "lec-px30_config"

KERNEL_DEVICETREE = "rockchip/px30-evb-ddr3-v10-linux.dtb"

MACHINE_ESSENTIAL_EXTRA_RDEPENDS += "kernel-devicetree rkbin-wifi"
```

## layers/meta-lec-px30/conf/machine/nanopc-t4.conf
```bitbake
#@TYPE: Machine
#@NAME: FriendlyElec NanoPC-T4
#@SOC: Rockchip RK3399
#@DESCRIPTION: Machine configuration for FriendlyElec NanoPC-T4

require conf/machine/include/arm/arch-armv8.inc
require conf/machine/include/soc-family.inc

PREFERRED_PROVIDER_virtual/bootloader = "u-boot-rockchip"
PREFERRED_PROVIDER_virtual/kernel = "linux-rockchip"
PREFERRED_VERSION_linux-rockchip = "4.4.179%"

UBOOT_MACHINE = "nanopi4_defconfig"

KERNEL_IMAGETYPE = "Image"

SERIAL_CONSOLES = "1500000;ttyS2"

KBUILD_DEFCONFIG = "nanopi4_linux_defconfig"

KERNEL_DEVICETREE = "rockchip/rk3399-nanopi4-rev00.dtb"

MACHINE_ESSENTIAL_EXTRA_RDEPENDS += "kernel-devicetree rkbin-wifi"
```
